#include <stdio.h>
#include <string.h>
#include "error_handling.h"
#include "debug_uart.h"
#include "adc.h"
#include "mosfets.h"
#include "temperature.h"
#include "temperature_lookup_table.h"

#define OVERHEAT_TEMPERATURE_THRESHOLD_ADC_VALUE 11900 // corresponding to 80 degrees C
//#define OVERHEAT_TEMPERATURE_THRESHOLD_ADC_VALUE 14000 // corresponding to 40 degrees C, used for testing

// This function uses the lookup table that is generated by the Python script called generate_lookup_table_and_plot_curves.py
// In that Python script, there is a function called estimate_temperature_from_integer_lookup_table(), and this function
// is closely based on it.
int16_t convert_adc_value_to_degrees_C(int16_t adc_value)
{
    int16_t adjusted_adc_value = (MAX_TEMPERATURE_SENSOR_ADC_VALUE - adc_value) - TEMPERATURE_ADC_MIN_VALUE;

    if(adjusted_adc_value < 0) {
        return 0;
    }
    uint8_t lookup_table_index = (adjusted_adc_value >> LOOKUP_TABLE_ADC_VALUE_SHIFT);
    if(lookup_table_index >= TEMPERATURE_LOOKUP_TABLE_SIZE) {
        return 0;
    }
    else {
        uint32_t temperature = temperature_lookup_table[lookup_table_index].temperature;
        uint32_t slope = temperature_lookup_table[lookup_table_index].slope;
        temperature >>= TEMPERATURE_LOOKUP_TABLE_SHIFT_LEFT;
        uint32_t temperature_slope_adjustment = (uint32_t)slope * (uint32_t)(adjusted_adc_value & ((1 << LOOKUP_TABLE_ADC_VALUE_SHIFT) - 1));
        temperature_slope_adjustment >>= TEMPERATURE_LOOKUP_TABLE_SLOPE_SHIFT_LEFT;
        return (int16_t)(temperature + temperature_slope_adjustment);
    }
}


int16_t get_temperature_degrees_C(void)
{
    uint16_t adc_value = get_temperature_ADC_value();
//    adc_value = OVERHEAT_TEMPERATURE_THRESHOLD_ADC_VALUE;
    return convert_adc_value_to_degrees_C(adc_value);
}


void print_temperature(void)
{
	char buf[60];
	int16_t adc_value = get_temperature_ADC_value();
	sprintf(buf, "Motor temperature ADC value: %d\n", (int)adc_value);
	transmit(buf, strlen(buf));
    int16_t temeprature_degrees_C = convert_adc_value_to_degrees_C(adc_value);
	sprintf(buf, "Motor temperature (degrees C): %d\n", (int)temeprature_degrees_C);
	transmit(buf, strlen(buf));
}


void check_if_overtemperature(void)
{
    if (is_mosfets_enabled()) {
        uint16_t ADC_value = get_temperature_ADC_value();
        if (ADC_value < OVERHEAT_TEMPERATURE_THRESHOLD_ADC_VALUE) {
            fatal_error(40);
        }
    }
}